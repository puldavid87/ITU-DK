#include <Arduino.h>
#include <avr/pgmspace.h>
#include <EEPROM.h>
// AES S-box (http://en.wikipedia.org/wiki/Rijndael_S-box)
//static uint8_t const sbox[256] = {
const PROGMEM uint8_t sbox [] = {
       0x63, 0x7C, 0x77, 0x7B, 0xF2, 0x6B, 0x6F, 0xC5,     // 0x00
       0x30, 0x01, 0x67, 0x2B, 0xFE, 0xD7, 0xAB, 0x76,
       0xCA, 0x82, 0xC9, 0x7D, 0xFA, 0x59, 0x47, 0xF0,     // 0x10
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       0x41, 0x99, 0x2D, 0x0F, 0xB0, 0x54, 0xBB, 0x16
   };
const PROGMEM uint8_t matrix [4][4]= {{0x02,0x03,0x01,0x01},
                                     {0x01,0x02,0x03,0x01},
                                     {0x01,0x01,0x02,0x03},
                                     {0x03,0x01,0x01,0x02}};
static uint8_t const limit = 4;     
uint8_t  i,j,k,h,l,m=0;
uint8_t temp;
uint8_t  rounds [4][4];
uint8_t  test[4];
uint8_t  ciper [4][4];
uint8_t  out [4][4];
uint8_t  g [4];

uint8_t rcon [4]={0x01,0x00,0x00,0x00};


void aes (uint8_t *text_in, uint8_t *key_in, uint8_t *text_out){
  //10 roundkey  
 for(m=0;m<10;m++){
  if(m==0){  //first round
    for(i=0;i<limit;i++){ //text and ciper arrays to matrix  [4][4]
     for(j=0;j<limit;j++){
        ciper[j][i]=key_in[k];
        out[j][i]=text_in[k]^ciper[j][i]; // result of first roundkey and first text output
        k++;
      }
    }
  }
  //g(w[3])
    temp=ciper[0][3];
    //adding round constat
    for(l=0;l<limit;l++){
      g[l]=ciper[l+1][3];
      g[l]=pgm_read_byte(&sbox[g[l]]);
    }
   g[3]=pgm_read_byte(&sbox[temp]);

 //second-ten roundkey
   for(i=0;i<limit;i++){
     for(j=0;j<limit;j++){
          temp=ciper[j][i];
          if(i==0){
            ciper[j][i]=temp^g[j]^rcon[j];
          }
          else{
            ciper[j][i]=ciper[j][i-1]^temp;
          }
       out[i][j]=pgm_read_byte(&sbox[out[i][j]]); //s-box to next roundkey
      }
    }
    //datamatrix left rotation 0,1,2 and 3
   for(i=1;i<limit;i++){ 
        for(l=0;l<i;l++){
          temp=out[i][0];
        for(j=0;j<3;j++){
          out[i][j]=out[i][j+1];
         }
       out[i][3]=temp;
      } 
   }
    //linear mix columns
    for(k=0;k<limit;k++){
      for(i=0;i<limit;i++){ 
       for(j=0;j<limit;j++){
          if (pgm_read_byte(&matrix[i][j])==0x02){
            h=(out[j][k]>>7)&1;
            temp=out[j][k]<<1;
            temp ^= h * 0x1B;
            test[j]=temp;
          }
          else if (pgm_read_byte(&matrix[i][j])==0x03){
            h=(out[j][k]>>7)&1;
            temp=out[j][k]<<1;
            temp ^= h * 0x1B;
            test[j]=temp^out[j][k];
          } 
          else {
            test[j]=out[j][k];
          } 
        } //for j
       rounds[i][k]=test[0]^test[1]^test[2]^test[3];
      } //for i
    } // for k
    //ciper xor state matrix
    for(i=0;i<limit;i++){
        for(j=0;j<limit;j++){
            if(m<9)
              out[i][j]=rounds[i][j]^ciper[i][j];
            else 
              out[i][j]=out[i][j]^ciper[i][j];
        }
   }
  
 // ciper round constat
    if (m<=6)
      rcon[0]=rcon[0]*2;
    else if (m==7)
      rcon[0]=0x1B;
   else  
      rcon[0]=0x36;
   } // end roundkey
   rcon [0]=0x01;
   rcon [1]=0x00;
   rcon [2]=0x00;
   rcon [3]=0x00;
  k=0;
  for(i=0;i<limit;i++){ //text and ciper arrays to matrix  [4][4]
     for(j=0;j<limit;j++){
       text_out[k]= out[j][i];
        k++;
      }
    }
   k=0;
 } 

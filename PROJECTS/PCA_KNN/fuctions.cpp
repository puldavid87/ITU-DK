#include <Arduino.h>
#include <avr/pgmspace.h>
/*
 * [[-0.51918001 -0.59645845  0.61196716 -0.01362484]
 [-0.85389968  0.38640748 -0.34820136 -0.01733228]]
 */
const PROGMEM float matriz [245][3]={
{0.33,0.02,1.0},
{0.68,-0.13,1.0},
{-0.18,0.25,2.0},
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{-0.26,0.17,2.0}
};

void setup_1(){
 Serial.begin(9600); 
 }

uint8_t knn (uint8_t k,uint8_t etiquetas, uint8_t tam_col, uint8_t tam_fil, float *datos_prueba){
float pca_vector[tam_col-1];
uint8_t col;
uint8_t fil;
uint8_t i=0;
uint8_t j; 
uint8_t etiqueta;
  float aux;
  float aux_eti=0;
  float sumatoria=0; // sumatoria de la elevación al cuadrado de cada col
  float distancia=0; // raiz de sumatoria
  
  /*matriz de k-vecinos
  |1|2|3| -> numero de vecinos
  |2|1|1| -> asginacion del vecino por etiqueta
  |0.1|0.2|0.3| -> distancia
  */
 float matriz_k [3][k];
 
  /* etiquetas
  |1|2|3| -> etiquetas que existe dentro de la base de datos
  |2|1|0| -> conteo de etiquetas dentro de los k-vecinos
   */
 int matriz_etiq[2][etiquetas];
  // asignar numero de vecinos y enceramos asignación de etiqueta

   for(;i<k;i++){
      matriz_k[0][i]=i+1.0;
      matriz_k[1][i]=0;
      matriz_k[2][i]=3000.0+i;
    /*
     |1|2|3|
     |0|0|0|
     |3000|3001|3002|
     */
    }
   // asignar etiquetas y enceramos su contador
   for(i=0;i<etiquetas;i++){
    matriz_etiq[0][i]=i+1;
    matriz_etiq[1][i]=0;
    /*
     |1|2|3| 
     |0|0|0|
     */
    }

    /*PASOS PARA K-NN
     * Leer cada fila de la matriz de entrenamiento
     * distancia entre la fila de la matriz con la nueva instancia (vector de prueba)
     * ordenar la matriz matriz_k (determinar los k vecinos de menor distancia)
     * contar las etiquetas en la matriz_k y asignar en matriz etiquetas
     * eligo al mayor número de matriz etiquetas
     * retorno la etiqueta resultante
     * 
     */
    
    pca_vector[0]= (-0.30*(datos_prueba[0]/828.0))+(-0.50*(datos_prueba[1]/660.0))+(0.81*(datos_prueba[2]/483.0))+(-0.11*(datos_prueba[3]/79.0));
    pca_vector[1]= (0.16*(datos_prueba[0]/828.0))+ (-0.70*(datos_prueba[1]/660.0)) +(-0.28*(datos_prueba[2]/483.0))+ (0.62*(datos_prueba[3]/79.0));

     for(fil=0;fil<tam_fil;fil++){
         for(col=0;col<tam_col-1;col++){ // menos 1 por ultima columna es etiqueta
             sumatoria=sumatoria+pow(pgm_read_float(&matriz[fil][tam_col-1])-pca_vector[col],2);
          }
             distancia=sqrt(sumatoria);
             // comparación de nuevo dato con solo la distacia mayor almacenada en matriz_k
              if(distancia<matriz_k[2][k-1]){
                 matriz_k[2][k-1]=distancia;
                 matriz_k[1][k-1]=pgm_read_float(&matriz[fil][tam_col-1]);//matriz[fil][tam_col-1];       //pgm_read_float(&matriz[fil][tam_col-1]);
                 //ordenar por metodo burbuja
                 for (i=0;i<k;i++){
                     for(j=i+1;j<k;j++){
                          if(matriz_k[2][i]>matriz_k[2][j]){
                            //distancia
                             aux=matriz_k[2][i];
                             matriz_k[2][i]=matriz_k[2][j];
                             matriz_k[2][j]=aux;
                             // etiqueta
                              aux_eti=matriz_k[1][i];
                             matriz_k[1][i]=matriz_k[1][j];
                             matriz_k[1][j]=aux_eti;
                            } //end if
                      } //end for
                  }
                 //fin ordenamiento 
              } 
              //fin condicion de numero menor
              sumatoria=0;
        }
        // fin de lectura de matriz
        // contar por columna, cuantos vecinos hay por etiqueta
        for(i=0;i<etiquetas;i++){
          for(j=0;j<k;j++){
              if(matriz_etiq[0][i]==matriz_k[1][j]){
                 matriz_etiq[1][i]++;
                }
            }
          }

         // buscar la etiqueta con mayor numero de vecinos
           aux_eti=-1.0;
        for(i=0;i<etiquetas-1;i++){
            if(matriz_etiq[1][i]>aux_eti){
              etiqueta=matriz_etiq[0][i];
              aux_eti=matriz_etiq[1][i];
            }
           // Serial.println(etiqueta);  
          }
        
        return etiqueta;    
     }
